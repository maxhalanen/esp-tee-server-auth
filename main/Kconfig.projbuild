## main/Kconfig.projbuild
```kconfig
menu "Example Configuration"

    config EXAMPLE_WIFI_SSID
        string "WiFi SSID"
        default "Rogers 1505"
        help
            SSID (network name) to connect to.

    config EXAMPLE_WIFI_PASSWORD
        string "WiFi Password"
        default "Max&12345"
        help
            WiFi password (WPA or WPA2) to use.

    config EXAMPLE_WIFI_MAXIMUM_RETRY
        int "Maximum retry"
        default 5
        help
            Maximum number of retries for WiFi connection before giving up.

    config EXAMPLE_TCP_PORT
        int "TCP Server Port"
        range 0 65535
        default 3333
        help
            The port on which the device listens for server commands.

    config EXAMPLE_LED_GPIO
        int "LED GPIO number"
        range 0 48
        default 0
        help
            GPIO number for the LED used in status verification.

    config EXAMPLE_BLINK_PERIOD_MS
        int "Blink period (ms)"
        range 1000 30000
        default 5000
        help
            LED toggle period in milliseconds.

endmenu
```
